## block/Kconfig.iosched.rej
```kconfig
diff a/block/Kconfig.iosched b/block/Kconfig.iosched	(rejected hunks)
@@ -64,6 +84,7 @@ endchoice
 config DEFAULT_IOSCHED
 	string
 	default "deadline" if DEFAULT_DEADLINE
+	default "row" if DEFAULT_ROW
 	default "cfq" if DEFAULT_CFQ
 	default "noop" if DEFAULT_NOOP
 
```

## drivers/cpufreq/Kconfig.rej
```kconfig
diff a/drivers/cpufreq/Kconfig b/drivers/cpufreq/Kconfig	(rejected hunks)
@@ -141,6 +141,16 @@ config CPU_FREQ_DEFAULT_GOV_HYPER
 	help
 	  Use the CPUFreq governor 'hyper' as default.
 
+config CPU_FREQ_DEFAULT_GOV_DYNAMIC_INTERACTIVE
+	bool "dynamic interactive"
+	select CPU_FREQ_GOV_DYNAMIC_INTERACTIVE
+	help
+	  Use the CPUFreq governor 'dynamic interactive' as default. This allows
+	  you to get a full dynamic cpu frequency capable system by simply
+	  loading your cpufreq low-level hardware driver, using the
+	  'interactive' governor for latency-sensitive workloads. This governor
+	  changes its tunables by itself depending on the load of the system.
+
 endchoice
 
 config CPU_FREQ_GOV_PERFORMANCE
@@ -263,6 +273,22 @@ config CPU_FREQ_GOV_HYPER
 	  'hyper' - a tweaked "ondemand" based smart and smooth optimized governor!
 
 	  If in doubt, say Y.
+config CPU_FREQ_GOV_DYNAMIC_INTERACTIVE
+	tristate "'dynamic interactive' cpufreq policy governor"
+	help
+	  'dynamic interactive' - This driver adds a dynamic cpufreq policy governor
+	  designed for latency-sensitive workloads.
+
+	  This governor attempts to reduce the latency of clock
+	  increases so that the system is more responsive to
+	  interactive workloads.
+
+	  To compile this driver as a module, choose M here: the
+	  module will be called cpufreq_interactive.
+
+	  For details, take a look at linux/Documentation/cpu-freq.
+
+	  If in doubt, say N.
 
 menu "x86 CPU frequency scaling drivers"
 depends on X86
```

## fs/Kconfig.rej
```kconfig
diff a/fs/Kconfig b/fs/Kconfig	(rejected hunks)
@@ -276,7 +276,7 @@ source "fs/dlm/Kconfig"
 
 config DYNAMIC_FSYNC
 	bool "dynamic file sync control"
-	default n
+	default y
 	help
 	  An experimental file sync control using Android's early suspend / late resume drivers
 
```
